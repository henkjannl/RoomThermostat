#include "a_constants.h"
#include "b_button.h"
#include "c_logger.h"
#include "d_interfaces.h"
#include "e_roomtemp.h"
#include "f_wifi.h"
#include "g_time.h"
#include "h_jpeg.h"
#include "i_display.h"
#include "j_boiler.h"
#include "k_controller.h"
#include "l_menu.h"
#include "m_telegram.h"

#include <esp_task_wdt.h>      // Watchdog timer
#define WATCHDOG_TIMEOUT 180   // 3 minute watchdog


// THIS VERSION IS WORKING, HAS A SCREEN, BUT THE BUTTON SOFTWARE IS VERY SLOW
// this version is from before the messaging system was introduced


/* TO DO:
  Make central store of variables, that can also be saved to / retrieved from permanent memory
  Add save and load of persistent data
  Do autosave if persistent data is changed
  
  Conflict between touchRead and SPIFFS is now resolved by disabling keyboard during use of screen. Perhaps sufficient to only disable during sprite.loadFont()
  Icons in front of menu items
  Create an additional debug screen (done in telegram)
  Allow user to modify water temperature of heater and shower
  Indicate day icons for overruled days with different color
  Replace setValue() and getValue() of DisplayParameter_t to property
  Try if SPI frequency in TFT_eSPI can be higher
  Check if D-action is implemented well in PID controller
*/

// Declaring all functional modules and connect them to each other
DataBus databus(&disableKeyboard, &enableKeyboard);                                       // Central bus that handles most communication
MenuStructure menu = MenuStructure(SCREENS);                                              // Screens and menus of hardware unit
OneWire oneWire(PIN_ONE_WIRE_BUS);                                                        // Bus for the temperature sensors 
DallasTemperature dallasSensor(&oneWire);                                                 // Driver for temperature sensors
TemperatureSensor temperatureSensor = TemperatureSensor(dallasSensor, databus);           // Temperature sensors
TFT_eSPI tft = TFT_eSPI();                                                                // Driver for display
Display display(tft, databus, menu, &disableKeyboard, &enableKeyboard);                   // Display
Backlight backlight(PIN_BACKLIGHT, databus);                                              // Backlight control
OpenTherm opentherm(PIN_OPENTHERM_IN, PIN_OPENTHERM_OUT);                                 // Driver for boiler
Boiler boiler = Boiler(opentherm, databus, display, &disableKeyboard, &enableKeyboard);   // Boiler control
Controller controller=Controller(databus, menu, temperatureSensor, display);              // Temperature controller
WiFiClientSecure securedClient;                                                           // Secure wifi client
UniversalTelegramBot bot("", securedClient);                                              // Driver for Telegram
TelegramHandler telegramHandler(databus, securedClient, bot, controller);                 // Telegram message handler 

//Interrupthandler for OpenTherm
void ICACHE_RAM_ATTR handleInterrupt() {
  opentherm.handleInterrupt();
}

void setup() {
  // Initilize serial port
  Serial.begin(115200);

  // Initialize SPIFFS
  SPIFFS.begin();
  delay(500);
  databus.loadConfig(SPIFFS, CONFIG_FILE);

  Serial.println("Initializing temperature sensors");
  temperatureSensor.begin();
  temperatureSensor.setOffset(-3.1);

  Serial.println("Initializing boiler interface");
  opentherm.begin(handleInterrupt);

  Serial.println("Initializing backlight");
  backlight.begin();

  Serial.println("Initializing display");
  display.begin();

  Serial.println("Initializing boiler");
  boiler.begin();

  Serial.println("Initializing WiFi");
  setupWifi(databus);

  Serial.println("Initializing keyboard");
  buttonsStart();

  Serial.println("Initializing Telegram handler");
  telegramHandler.begin();

  // Refresh screen first time
  controller.control();

  // Enable watchdog
  Serial.println("Configuring watchdog");
  esp_task_wdt_init(WATCHDOG_TIMEOUT, true); //enable panic so ESP32 restarts
  esp_task_wdt_add(NULL); //add current thread to WDT watch

  Serial.println("Setup finished");
}

void loop() {
  static int counter =0;

  // Handle key presses generated by the interrupt routine
  if(btnUpTouched)     { btnUpTouched     = false;  menuUpButtonPressed    (databus, menu, backlight, controller);     }
  if(btnSelectTouched) { btnSelectTouched = false;  menuSelectButtonPressed(databus, menu, backlight, controller); }
  if(btnDownTouched)   { btnDownTouched   = false;  menuDownButtonPressed  (databus, menu, backlight, controller);   }

  if(++counter % 100 ==0) {
    temperatureSensor.loop(); // Reconnect temperature sensors if a bad reading has occurred
    boiler.loop();
    controller.loop();
    backlight.loop();  
    telegramHandler.loop();
    reconnectIfNeeded(databus);
    requestTimeZoneIfNeeded(databus);
    syncTimeIfNeeded(databus);
  }
    
  // Reset watchdog timer
  esp_task_wdt_reset();      
}
